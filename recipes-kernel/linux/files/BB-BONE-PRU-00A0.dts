/*
 * Copyright (C) 2012 Texas Instruments Incorporated - http://www.ti.com/
 *
 * This program is free software; you can redistribute it and/or modify
 * it under the terms of the GNU General Public License version 2 as
 * published by the Free Software Foundation.
 */
/dts-v1/;

#include "am33xx.dtsi"
#include "am335x-bone-common.dtsi"
#include <dt-bindings/display/tda998x.h>

/ {
        model = "TI AM335x BeagleBone Black";
        compatible = "ti,am335x-bone-black", "ti,am335x-bone", "ti,am33xx";

	/* identification */
  	part-number = "BB-BONE-PRU";
  	version = "00A0";

  	exclusive-use = "P8.11", "P8.12", "P9.25", "P9.27", "P8.15", "P8.16", "P9.30";

	fragment@0 {
		target = <&am33xx_pinmux>;
    		__overlay__ {
      			mygpio: pinmux_mygpio {
        			pinctrl-single,pins = <
          			0x34 0x06  /* MOTOR (P8.11) */
          			0x30 0x06  /* VALVE1 (P8.12) */
          			0x1ac 0x05  /* VALVE2 (P9.25) */
          			0x1a4 0x05  /* VALVE3 (P9.27) */
          			0x3c 0x36  /* PULSECOUNTER (P8.15) */
          			0x38 0x36  /* LIGHTBARRIER1 (P8.16) */
          			0x184 0x36  /* LIGHTBARRIER2 (P9.24) */
          			0x198 0x36  /* LIGHTBARRIER3_TO_5 (P9.30) */
        			>;
      			};
    		};
	};
/*
	fragment@1 {
    		target = <&ocp>;
    		__overlay__ {
      			test_helper: helper {
        			compatible = "bone-pinmux-helper";
        			pinctrl-names = "default";
        			pinctrl-0 = <&mygpio>;
        			status = "okay";
      			};
    		};
  	};
*/
	fragment@2{
		target = <&pruss>;
		__overlay__ {
			status = "okay";
		};
	};
};

