## conf/distro/farbsort.conf
```bitbake
require conf/distro/poky.conf

DISTRO = "farbsort"
DISTRO_NAME = "FarbSort"

LICENSE_FLAGS_WHITELIST = "commercial"

MAINTAINER = "Juergen Messerer"

DISTRO_VERSION = "0.1.0"

MACHINE ?= "beaglebone"

PACKAGECONFIG_append_pn-qtbase = "debug linuxfb accessibility gles2 eglfs no-kms fontconfig freetype icu \
                                  udev widgets pulseaudio alsa openssl evdev no-xcb no-xkbcommon no-xkbcommon-evdev"


PACKAGECONFIG_remove_pn-qttools  = "qtwebkit"
PACKAGECONFIG_remove_pn-qtquick1 = "qtwebkit"
PACKAGECONFIG_remove_pn-qtbase   = "qtwebkit"


POKY_DISTRO_FEATURES = "ipv4 ipv6 systemd"
DISTRO_FEATURES = "${DISTRO_FEATURES_LIBC_DEFAULT} ${POKY_DISTRO_FEATURES}"
DISTRO_FEATURES_remove = "sysvinit bluez5 x11  wayland"


VIRTUAL-RUNTIME_init_manager = "systemd"

PACKAGE_CLASSES = "package_ipk"

RM_OLD_IMAGE = "1"
#EXTRA_IMAGE_FEATURES = "debug-tweaks tools-debug"

PREFERRED_PROVIDER_virtual/egl = "ti-sgx-ddk-um"
PREFERRED_PROVIDER_virtual/libgles1 = "ti-sgx-ddk-um"
PREFERRED_PROVIDER_virtual/libgles2 = "ti-sgx-ddk-um"
#PREFERRED_PROVIDER_libgbm = "libgbm"
#PREFERRED_PROVIDER_libgbm-dev = "libgbm-dev"
```

## conf/layer.conf
```bitbake
# We have a conf and classes directory, add to BBPATH
BBPATH .= ":${LAYERDIR}"

# We have recipes-* directories, add to BBFILES
BBFILES += "${LAYERDIR}/recipes-*/*/*.bb \
            ${LAYERDIR}/recipes-*/*/*.bbappend \
            ${LAYERDIR}/images/*.bb"

BBFILE_COLLECTIONS      += "farbsort"
BBFILE_PATTERN_farbsort  = "^${LAYERDIR}/"
BBFILE_PRIORITY_farbsort = "7"
LAYERVERSION_farbsort    = "3"

LAYERDEPENDS_farbsort = "core yocto openembedded-layer qt5-layer"
```

## conf/machine/farbsort-beaglebone.conf
```bitbake
#@TYPE: farbsort-beaglebone
#@NAME: Beaglebone machine
#@DESCRIPTION: Machine configuration for http://beagleboard.org/bone and http://beagleboard.org/black boards

MACHINE_EXTRA_RRECOMMENDS = " kernel-modules kernel-devicetree"

EXTRA_IMAGEDEPENDS += "u-boot"

DEFAULTTUNE ?= "cortexa8hf-neon"
include conf/machine/include/tune-cortexa8.inc

SERIAL_CONSOLE = "115200 ttyO0"

#PREFERRED_PROVIDER_virtual/kernel ?= "linux-ti-staging"
#PREFERRED_VERSION_linux-ti-staging ?= "4.4%"

KERNEL_IMAGETYPE = "uImage"
KERNEL_DEVICETREE = "am335x-bone.dtb am335x-boneblack.dtb"
KERNEL_EXTRA_ARGS += "LOADADDR=${UBOOT_ENTRYPOINT}"

SPL_BINARY = "MLO"
UBOOT_SUFFIX = "img"
UBOOT_MACHINE = "am335x_evm_config"
UBOOT_ENTRYPOINT = "0x80008000"
UBOOT_LOADADDRESS = "0x80008000"
```
